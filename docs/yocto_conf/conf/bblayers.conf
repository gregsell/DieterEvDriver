## docs/yocto_conf/conf/bblayers.conf
```bitbake
# POKY_BBLAYERS_CONF_VERSION is increased each time build/conf/bblayers.conf
# changes incompatibly
POKY_BBLAYERS_CONF_VERSION = "2"

BBPATH = "${TOPDIR}"
BBFILES ?= ""

BBLAYERS ?= " \
  /home/$USER/yocto-everest/poky/meta \
  /home/$USER/yocto-everest/poky/meta-poky \
  /home/$USER/yocto-everest/poky/meta-yocto-bsp \
  /home/$USER/yocto-everest/poky/meta-openembedded/meta-oe \
  /home/$USER/yocto-everest/poky/meta-openembedded/meta-python \
  /home/$USER/yocto-everest/poky/meta-openembedded/meta-networking \
  /home/$USER/yocto-everest/poky/meta-raspberrypi \
  /home/$USER/yocto-everest/poky/meta-everest \
  /home/$USER/yocto-everest/poky/meta-pev_sim \
  /home/$USER/yocto-everest/poky/meta-openjdk-temurin \
  "
```

## docs/yocto_conf/conf/local.conf
```bitbake
MACHINE = "raspberrypi3-64"

# Parallelization (adjust to your CPU)
BB_NUMBER_THREADS = "10"
PARALLEL_MAKE = "-j 10"

# Disk space monitoring
BB_DISKMON_DIRS = "STOPTASKS,${TMPDIR},1G,100K STOPTASKS,${DL_DIR},1G,100K"

# Add EVerest to image
IMAGE_INSTALL:append = " everest-core mosquitto python3 kernel-module-cdc-acm kernel-module-ch341 kernel-module-usbserial dieter-ev-driver python3-iso15118 openjdk-17-jre tshark" 


ENABLE_UART = "1"

DISTRO_FEATURES:append = " systemd usrmerge wifi"
INIT_MANAGER = "systemd"

LICENSE_FLAGS_ACCEPTED = "synaptics-killswitch"

EVEREST_CORE_PATH = "/path/to/evereste"
BBMASK += "meta-everest/recipes-connectivity/openssl/"

# common download cache for all builds
DL_DIR = "/some/shared/directory"

# common sstate cache (reusable build artefacts)
SSTATE_DIR = "/another/shared/directory"

# root login without password
EXTRA_IMAGE_FEATURES += "debug-tweaks"
```

## yocto/scarthgap/meta-pev_sim/conf/layer.conf
```bitbake
BBPATH .= ":${LAYERDIR}"
BBFILES += "${LAYERDIR}/recipes-*/*/*.bb \
            ${LAYERDIR}/recipes-*/*/*.bbappend"

BBFILE_COLLECTIONS += "meta-pev-sim"
BBFILE_PATTERN_meta-pev-sim = "^${LAYERDIR}/"
BBFILE_PRIORITY_meta-pev-sim = "10"
LAYERSERIES_COMPAT_meta-pev-sim = "scarthgap"

LAYERDEPENDS_meta-pev-sim = "core meta-everest"
```
